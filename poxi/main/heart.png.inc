/* THIS FILE IS AUTO-GENERATED BY THE CLOWNFISH SSD1306Converter TOOL!                 */
/* DON'T MODIFY IT BY HAND SINCE IT CAN GET REPLACED AUTOMATICALLY.                    */

/* The generated code is a font or image for the SSD1306Driver. */
/* generation date: Mon Dec 27 16:58:46 CET 2021 */

#define HEART_PNG_WIDTH		24

#define HEART_PNG_HEIGHT	25

static const uint8_t heart_png[] = {
	0xe0, 0xf8, 0xfc, 0x3e, 0x0e, 0x07, 0x07, 0x0f, 0x0e, 0x3e, 0xfc, 0xf8, 0xf8, 0xfc, 0x3e, 0x0e, 0x0f, 0x07, 0x07, 0x0e, 0x3e, 0xfc, 0xf8, 0xe0, // line 0
	0x07, 0x3f, 0xff, 0xfc, 0xe0, 0x80, 0x00, 0x00, 0x00, 0x00, 0x00, 0x01, 0x01, 0x00, 0x00, 0x00, 0x00, 0x00, 0x80, 0xc0, 0xf8, 0xff, 0x3f, 0x07, // line 1
	0x00, 0x00, 0x00, 0x03, 0x07, 0x0f, 0x1e, 0x3c, 0x78, 0xf0, 0xe0, 0xe0, 0xc0, 0xe0, 0xf0, 0x78, 0x3c, 0x1e, 0x0f, 0x07, 0x03, 0x00, 0x00, 0x00, // line 2
	0x00, 0x00, 0x00, 0x00, 0x00, 0x00, 0x00, 0x00, 0x00, 0x00, 0x00, 0x01, 0x01, 0x00, 0x00, 0x00, 0x00, 0x00, 0x00, 0x00, 0x00, 0x00, 0x00, 0x00, // line 3
};

