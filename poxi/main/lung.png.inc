/* THIS FILE IS AUTO-GENERATED BY THE CLOWNFISH SSD1306Converter TOOL!                 */
/* DON'T MODIFY IT BY HAND SINCE IT CAN GET REPLACED AUTOMATICALLY.                    */

/* The generated code is a font or image for the SSD1306Driver. */
/* generation date: Mon Dec 27 16:58:57 CET 2021 */

#define LUNG_PNG_WIDTH		26

#define LUNG_PNG_HEIGHT		22

static const uint8_t lung_png[] = {
	0x00, 0x00, 0x80, 0xc0, 0x60, 0x30, 0x10, 0x18, 0x18, 0x98, 0x18, 0x5f, 0x60, 0x60, 0x5f, 0x98, 0x18, 0x18, 0x18, 0x10, 0x30, 0x60, 0xc0, 0x00, 0x00, 0x00, // line 0
	0xf0, 0xfe, 0x03, 0x08, 0x84, 0x42, 0x42, 0xf2, 0x0f, 0x01, 0x00, 0xc0, 0xc0, 0xc0, 0x80, 0x00, 0x01, 0x0f, 0xf2, 0x46, 0xc8, 0x88, 0x01, 0x07, 0xfe, 0xf0, // line 1
	0x07, 0x1f, 0x38, 0x30, 0x30, 0x30, 0x30, 0x1b, 0x18, 0x18, 0x0e, 0x07, 0x00, 0x01, 0x07, 0x0e, 0x18, 0x18, 0x18, 0x30, 0x30, 0x30, 0x30, 0x38, 0x1f, 0x07, // line 2
};
