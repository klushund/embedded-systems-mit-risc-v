/* THIS FILE IS AUTO-GENERATED BY THE CLOWNFISH SSD1306Converter TOOL!                 */
/* DON'T MODIFY IT BY HAND SINCE IT CAN GET REPLACED AUTOMATICALLY.                    */

/* The generated code is a font or image for the SSD1306Driver. */
/* generation date: Mon Dec 27 19:09:56 CET 2021 */

#define LEFT_BACK_PNG_WIDTH		6

#define LEFT_BACK_PNG_HEIGHT	64

static const uint8_t left_back_png[] = {
	0xff, 0xff, 0x03, 0x03, 0x03, 0x03, // line 0
	0xff, 0xff, 0x00, 0x00, 0x00, 0x00, // line 1
	0xff, 0xff, 0x00, 0x00, 0x00, 0x00, // line 2
	0xff, 0xff, 0x80, 0x00, 0x00, 0x00, // line 3
	0xff, 0xff, 0x01, 0x00, 0x00, 0x00, // line 4
	0xff, 0xff, 0x00, 0x00, 0x00, 0x00, // line 5
	0xff, 0xff, 0x00, 0x00, 0x00, 0x00, // line 6
	0xff, 0xff, 0xc0, 0xc0, 0xc0, 0xc0, // line 7
};
