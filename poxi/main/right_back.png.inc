/* THIS FILE IS AUTO-GENERATED BY THE CLOWNFISH SSD1306Converter TOOL!                 */
/* DON'T MODIFY IT BY HAND SINCE IT CAN GET REPLACED AUTOMATICALLY.                    */

/* The generated code is a font or image for the SSD1306Driver. */
/* generation date: Mon Dec 27 19:10:09 CET 2021 */

#define RIGHT_BACK_PNG_WIDTH		6

#define RIGHT_BACK_PNG_HEIGHT		64

static const uint8_t right_back_png[] = {
	0x03, 0x03, 0x03, 0x03, 0xff, 0xff, // line 0
	0x00, 0x00, 0x00, 0x00, 0xff, 0xff, // line 1
	0x00, 0x00, 0x00, 0x00, 0xff, 0xff, // line 2
	0x00, 0x00, 0x00, 0x80, 0xff, 0xff, // line 3
	0x00, 0x00, 0x00, 0x01, 0xff, 0xff, // line 4
	0x00, 0x00, 0x00, 0x00, 0xff, 0xff, // line 5
	0x00, 0x00, 0x00, 0x00, 0xff, 0xff, // line 6
	0xc0, 0xc0, 0xc0, 0xc0, 0xff, 0xff, // line 7
};
