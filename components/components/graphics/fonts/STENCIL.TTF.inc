/* THIS FILE IS AUTO-GENERATED BY THE CLOWNFISH SSD1306Converter TOOL!                 */
/* DON'T MODIFY IT BY HAND SINCE IT CAN GET REPLACED AUTOMATICALLY.                    */

/* The generated code is a font or image for the SSD1306Driver. */
/* generation date: Wed Dec 22 21:47:44 CET 2021 */

/* *** Font >Stencil< *** */
#define SSD1306_FONT_Stencil_16_CHARACTERCOUNT			256

static const uint8_t gFont_Stencil_16_Characters[] = {
	0x0, 0xff, 0x1, 0x1, 0x1, 0xff, 0x0, 0xf, 0x8, 0x8, 0x8, 0xf, 	// character, code 0
		// character, code 1
		// character, code 2
		// character, code 3
		// character, code 4
		// character, code 5
		// character, code 6
		// character, code 7
		// character, code 8
	0x0, 0x0, 	// character, code 9
	0x0, 0x0, 	// character, code 10
		// character, code 11
		// character, code 12
	0x0, 0x0, 	// character, code 13
		// character, code 14
		// character, code 15
		// character, code 16
		// character, code 17
		// character, code 18
		// character, code 19
		// character, code 20
		// character, code 21
		// character, code 22
		// character, code 23
		// character, code 24
		// character, code 25
		// character, code 26
		// character, code 27
		// character, code 28
		// character, code 29
		// character, code 30
		// character, code 31
	0x0, 0x0, 0x0, 0x0, 0x0, 0x0, 0x0, 0x0, 	// character, code 32
	0x0, 0x1e, 0xfe, 0x1e, 0x0, 0x0, 0xe, 0xe, 0xe, 0x0, 	// character, code 33
	0x0, 0x3e, 0x3e, 0x0, 0x3e, 0x3e, 0x0, 0x0, 0x0, 0x0, 0x0, 0x0, 0x0, 0x0, 	// character, code 34
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	0x2, 0x1, 0x1, 0x2, 0x2, 0x1, 0x0, 0x0, 0x0, 0x0, 0x0, 0x0, 	// character ~, code 126
		// character , code 127
		// character ?, code 128
		// character ?, code 129
		// character ?, code 130
		// character ?, code 131
		// character ?, code 132
		// character ?, code 133
		// character ?, code 134
		// character ?, code 135
		// character ?, code 136
		// character ?, code 137
		// character ?, code 138
		// character ?, code 139
		// character ?, code 140
		// character ?, code 141
		// character ?, code 142
		// character ?, code 143
		// character ?, code 144
		// character ?, code 145
		// character ?, code 146
		// character ?, code 147
		// character ?, code 148
		// character ?, code 149
		// character ?, code 150
		// character ?, code 151
		// character ?, code 152
		// character ?, code 153
		// character ?, code 154
		// character ?, code 155
		// character ?, code 156
		// character ?, code 157
		// character ?, code 158
		// character ?, code 159
	0x0, 0x0, 0x0, 0x0, 0x0, 0x0, 0x0, 0x0, 	// character  , code 160
	0x0, 0xe, 0xee, 0xe, 0x0, 0x0, 0xf, 0xf, 0xf, 0x0, 	// character ¡, code 161
	0x0, 0xe0, 0xf0, 0xf8, 0xc, 0x38, 0x38, 0x30, 0x0, 0x0, 0x1, 0x3, 0x3, 0xe, 0x2, 0x2, 0x1, 0x0, 	// character ¢, code 162
	0x0, 0x0, 0xbc, 0xfe, 0xfe, 0x9a, 0x9e, 0x1c, 0x0, 0x0, 0xc, 0xe, 0xe, 0xf, 0xe, 0xe, 0x7, 0x0, 	// character £, code 163
	0x4, 0xee, 0xfc, 0x18, 0x1c, 0x4, 0x18, 0x18, 0xfc, 0xee, 0x4, 0x4, 0x6, 0x3, 0x3, 0x6, 0x0, 0x6, 0x3, 0x3, 0x6, 0x4, 	// character ¤, code 164
	0x2, 0xae, 0xfe, 0xfe, 0xf2, 0xc0, 0xb2, 0xae, 0x2, 0x0, 0x0, 0x8, 0xf, 0xf, 0xf, 0x8, 0x0, 0x0, 	// character ¥, code 165
	0x7e, 0x7e, 0x7c, 0x7c, 	// character ¦, code 166
	0xc0, 0xdc, 0xbe, 0x3a, 0x72, 0xf6, 0xee, 0xc0, 0x1, 0x3b, 0x37, 0x27, 0x2f, 0x3e, 0x1d, 0x1, 	// character §, code 167
	0x0, 0x0, 0x0, 0x0, 0x0, 0x0, 0x0, 0x0, 0x0, 0x0, 0x0, 0x0, 0x0, 0x0, 0x0, 0x0, 	// character ¨, code 168
	0x0, 0xf0, 0xc, 0xf4, 0xfa, 0xa, 0xa, 0x3a, 0x4, 0xc, 0xf0, 0x0, 0x0, 0x1, 0x2, 0x5, 0x9, 0xa, 0xa, 0x9, 0x4, 0x2, 0x1, 0x0, 	// character ©, code 169
	0x0, 0xb6, 0xba, 0xbe, 0xbe, 0x30, 0x0, 0x0, 0x0, 0x0, 0x0, 0x0, 	// character ª, code 170
	0x0, 0xc0, 0xf0, 0x18, 0xc0, 0xf0, 0xb8, 0x10, 0x0, 0x0, 0x0, 0x3, 0x3, 0x0, 0x1, 0x3, 0x1, 0x0, 	// character «, code 171
	0x0, 0x0, 0x0, 0x0, 0x0, 0x0, 0x0, 0x1, 0x1, 0x1, 0x1, 0xf, 0xf, 0xf, 	// character ¬, code 172
	0xc0, 0xc0, 0xc0, 0xc0, 0x0, 0x0, 0x0, 0x0, 	// character ­, code 173
	0x0, 0xf0, 0xc, 0xf4, 0xf2, 0x2, 0x4a, 0xfa, 0xb4, 0xc, 0xf0, 0x0, 0x0, 0x1, 0x2, 0x7, 0xb, 0xa, 0x8, 0xb, 0x7, 0x3, 0x1, 0x0, 	// character ®, code 174
		// character ¯, code 175
	0x0, 0x0, 0x1c, 0x26, 0x26, 0x1c, 0x0, 0x0, 0x0, 0x0, 0x0, 0x0, 0x0, 0x0, 0x0, 0x0, 	// character °, code 176
	0x0, 0xc0, 0xc0, 0xc0, 0xf8, 0xf8, 0xc0, 0xc0, 0xc0, 0x0, 0x18, 0x18, 0x18, 0x1b, 0x1b, 0x18, 0x18, 0x18, 	// character ±, code 177
	0x8c, 0x4e, 0x60, 0xde, 0xcc, 0x0, 0x0, 0x0, 0x0, 0x0, 0x0, 0x0, 	// character ², code 178
	0x66, 0xe6, 0x2, 0xfe, 0x6c, 0x0, 0x0, 0x0, 0x0, 0x0, 0x0, 0x0, 	// character ³, code 179
	0x0, 0x0, 0x0, 0x1, 0x1, 0x0, 0x0, 0x0, 0x0, 0x0, 0x0, 0x0, 0x0, 0x0, 0x0, 0x0, 	// character ´, code 180
	0x0, 0xe0, 0xe0, 0x0, 0x0, 0xe0, 0xe0, 0x0, 0x78, 0x67, 0xf, 0x8, 0x8, 0xf, 0xf, 0x8, 	// character µ, code 181
	0x3c, 0x7e, 0xfe, 0x82, 0x80, 0xfe, 0xfe, 0x0, 0x0, 0xfe, 0xfe, 0x0, 0x2, 0xe, 0x0, 0x0, 0x0, 0x0, 0x20, 0x3f, 0x3f, 0x20, 0x20, 0x3f, 0x3f, 0x20, 0x0, 0x0, 	// character ¶, code 182
		// character ·, code 183
	0x0, 0x0, 0x0, 0x0, 0x0, 0x0, 0x0, 0x0, 0x0, 0x0, 0x0, 0xe0, 0x60, 0x0, 0x0, 0x0, 	// character ¸, code 184
	0x0, 0x82, 0xfe, 0xfe, 0x80, 0x0, 0x0, 0x0, 0x0, 0x0, 0x0, 0x0, 	// character ¹, code 185
	0x0, 0x9c, 0xbe, 0xbe, 0x9c, 0x0, 0x0, 0x0, 0x0, 0x0, 0x0, 0x0, 	// character º, code 186
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	0x2, 0xfe, 0xfe, 0xfe, 0x2, 0x0, 0x8, 0xf8, 0xf8, 0xf0, 0x8, 0xf, 0xf, 0xf, 0x8, 0x0, 0x1, 0x1, 0x1, 0x0, 	// character Þ, code 222
		// character ß, code 223
	0x0, 0x0, 0xe8, 0x10, 0x3e, 0xff, 0xfe, 0xf8, 0x0, 0x0, 0x8, 0xe, 0x9, 0x1, 0x1, 0x9, 0xf, 0xf, 0xf, 0x8, 	// character à, code 224
	0x0, 0x0, 0xe8, 0x10, 0x3f, 0xfe, 0xfe, 0xf8, 0x0, 0x0, 0x8, 0xe, 0x9, 0x1, 0x1, 0x9, 0xf, 0xf, 0xf, 0x8, 	// character á, code 225
	0x0, 0x0, 0xe8, 0x11, 0x3f, 0xff, 0xff, 0xf9, 0x0, 0x0, 0x8, 0xe, 0x9, 0x1, 0x1, 0x9, 0xf, 0xf, 0xf, 0x8, 	// character â, code 226
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	0x2, 0xe, 0x7e, 0xfe, 0xf2, 0xc1, 0x23, 0x1a, 0x6, 0x2, 0x0, 0x0, 0x8, 0xf, 0xf, 0xf, 0x8, 0x0, 0x0, 0x0, 	// character ÿ, code 255
};

static const uint16_t gFont_Stencil_16_CharacterOffsets[] = {
	0 /* code 0 */,
	12 /* code 1 */,
	12 /* code 2 */,
	12 /* code 3 */,
	12 /* code 4 */,
	12 /* code 5 */,
	12 /* code 6 */,
	12 /* code 7 */,
	12 /* code 8 */,
	12 /* code 9 */,
	14 /* code 10 */,
	16 /* code 11 */,
	16 /* code 12 */,
	16 /* code 13 */,
	18 /* code 14 */,
	18 /* code 15 */,
	18 /* code 16 */,
	18 /* code 17 */,
	18 /* code 18 */,
	18 /* code 19 */,
	18 /* code 20 */,
	18 /* code 21 */,
	18 /* code 22 */,
	18 /* code 23 */,
	18 /* code 24 */,
	18 /* code 25 */,
	18 /* code 26 */,
	18 /* code 27 */,
	18 /* code 28 */,
	18 /* code 29 */,
	18 /* code 30 */,
	18 /* code 31 */,
	18 /* code 32 */,
	26 /* code 33 */,
	36 /* code 34 */,
	50 /* #, code 35 */,
	68 /* $, code 36 */,
	86 /* %, code 37 */,
	110 /* &, code 38 */,
	132 /* ', code 39 */,
	140 /* (, code 40 */,
	154 /* ), code 41 */,
	168 /* *, code 42 */,
	186 /* +, code 43 */,
	204 /* ,, code 44 */,
	214 /* -, code 45 */,
	222 /* ., code 46 */,
	232 /* /, code 47 */,
	242 /* 0, code 48 */,
	260 /* 1, code 49 */,
	278 /* 2, code 50 */,
	296 /* 3, code 51 */,
	314 /* 4, code 52 */,
	332 /* 5, code 53 */,
	350 /* 6, code 54 */,
	368 /* 7, code 55 */,
	386 /* 8, code 56 */,
	404 /* 9, code 57 */,
	422 /* :, code 58 */,
	432 /* ;, code 59 */,
	442 /* <, code 60 */,
	456 /* =, code 61 */,
	474 /* >, code 62 */,
	488 /* ?, code 63 */,
	506 /* @, code 64 */,
	528 /* A, code 65 */,
	548 /* B, code 66 */,
	570 /* C, code 67 */,
	588 /* D, code 68 */,
	608 /* E, code 69 */,
	626 /* F, code 70 */,
	644 /* G, code 71 */,
	664 /* H, code 72 */,
	688 /* I, code 73 */,
	700 /* J, code 74 */,
	718 /* K, code 75 */,
	742 /* L, code 76 */,
	760 /* M, code 77 */,
	786 /* N, code 78 */,
	808 /* O, code 79 */,
	828 /* P, code 80 */,
	848 /* Q, code 81 */,
	868 /* R, code 82 */,
	890 /* S, code 83 */,
	908 /* T, code 84 */,
	928 /* U, code 85 */,
	950 /* V, code 86 */,
	970 /* W, code 87 */,
	996 /* X, code 88 */,
	1016 /* Y, code 89 */,
	1036 /* Z, code 90 */,
	1052 /* [, code 91 */,
	1064 /* \, code 92 */,
	1074 /* ], code 93 */,
	1086 /* ^, code 94 */,
	1104 /* _, code 95 */,
	1120 /* `, code 96 */,
	1136 /* a, code 97 */,
	1156 /* b, code 98 */,
	1178 /* c, code 99 */,
	1196 /* d, code 100 */,
	1216 /* e, code 101 */,
	1234 /* f, code 102 */,
	1252 /* g, code 103 */,
	1272 /* h, code 104 */,
	1296 /* i, code 105 */,
	1308 /* j, code 106 */,
	1326 /* k, code 107 */,
	1350 /* l, code 108 */,
	1368 /* m, code 109 */,
	1394 /* n, code 110 */,
	1416 /* o, code 111 */,
	1436 /* p, code 112 */,
	1456 /* q, code 113 */,
	1476 /* r, code 114 */,
	1498 /* s, code 115 */,
	1516 /* t, code 116 */,
	1536 /* u, code 117 */,
	1558 /* v, code 118 */,
	1578 /* w, code 119 */,
	1604 /* x, code 120 */,
	1624 /* y, code 121 */,
	1644 /* z, code 122 */,
	1660 /* {, code 123 */,
	1674 /* |, code 124 */,
	1678 /* }, code 125 */,
	1692 /* ~, code 126 */,
	1704 /* , code 127 */,
	1704 /* ?, code 128 */,
	1704 /* ?, code 129 */,
	1704 /* ?, code 130 */,
	1704 /* ?, code 131 */,
	1704 /* ?, code 132 */,
	1704 /* ?, code 133 */,
	1704 /* ?, code 134 */,
	1704 /* ?, code 135 */,
	1704 /* ?, code 136 */,
	1704 /* ?, code 137 */,
	1704 /* ?, code 138 */,
	1704 /* ?, code 139 */,
	1704 /* ?, code 140 */,
	1704 /* ?, code 141 */,
	1704 /* ?, code 142 */,
	1704 /* ?, code 143 */,
	1704 /* ?, code 144 */,
	1704 /* ?, code 145 */,
	1704 /* ?, code 146 */,
	1704 /* ?, code 147 */,
	1704 /* ?, code 148 */,
	1704 /* ?, code 149 */,
	1704 /* ?, code 150 */,
	1704 /* ?, code 151 */,
	1704 /* ?, code 152 */,
	1704 /* ?, code 153 */,
	1704 /* ?, code 154 */,
	1704 /* ?, code 155 */,
	1704 /* ?, code 156 */,
	1704 /* ?, code 157 */,
	1704 /* ?, code 158 */,
	1704 /* ?, code 159 */,
	1704 /*  , code 160 */,
	1712 /* ¡, code 161 */,
	1722 /* ¢, code 162 */,
	1740 /* £, code 163 */,
	1758 /* ¤, code 164 */,
	1780 /* ¥, code 165 */,
	1798 /* ¦, code 166 */,
	1802 /* §, code 167 */,
	1818 /* ¨, code 168 */,
	1834 /* ©, code 169 */,
	1858 /* ª, code 170 */,
	1870 /* «, code 171 */,
	1888 /* ¬, code 172 */,
	1902 /* ­, code 173 */,
	1910 /* ®, code 174 */,
	1934 /* ¯, code 175 */,
	1934 /* °, code 176 */,
	1950 /* ±, code 177 */,
	1968 /* ², code 178 */,
	1980 /* ³, code 179 */,
	1992 /* ´, code 180 */,
	2008 /* µ, code 181 */,
	2024 /* ¶, code 182 */,
	2052 /* ·, code 183 */,
	2052 /* ¸, code 184 */,
	2068 /* ¹, code 185 */,
	2080 /* º, code 186 */,
	2092 /* », code 187 */,
	2110 /* ¼, code 188 */,
	2136 /* ½, code 189 */,
	2162 /* ¾, code 190 */,
	2188 /* ¿, code 191 */,
	2206 /* À, code 192 */,
	2226 /* Á, code 193 */,
	2246 /* Â, code 194 */,
	2266 /* Ã, code 195 */,
	2286 /* Ä, code 196 */,
	2306 /* Å, code 197 */,
	2326 /* Æ, code 198 */,
	2354 /* Ç, code 199 */,
	2372 /* È, code 200 */,
	2390 /* É, code 201 */,
	2408 /* Ê, code 202 */,
	2426 /* Ë, code 203 */,
	2444 /* Ì, code 204 */,
	2456 /* Í, code 205 */,
	2468 /* Î, code 206 */,
	2480 /* Ï, code 207 */,
	2492 /* Ð, code 208 */,
	2512 /* Ñ, code 209 */,
	2534 /* Ò, code 210 */,
	2554 /* Ó, code 211 */,
	2574 /* Ô, code 212 */,
	2594 /* Õ, code 213 */,
	2614 /* Ö, code 214 */,
	2634 /* ×, code 215 */,
	2652 /* Ø, code 216 */,
	2672 /* Ù, code 217 */,
	2694 /* Ú, code 218 */,
	2716 /* Û, code 219 */,
	2738 /* Ü, code 220 */,
	2760 /* Ý, code 221 */,
	2780 /* Þ, code 222 */,
	2800 /* ß, code 223 */,
	2800 /* à, code 224 */,
	2820 /* á, code 225 */,
	2840 /* â, code 226 */,
	2860 /* ã, code 227 */,
	2880 /* ä, code 228 */,
	2900 /* å, code 229 */,
	2920 /* æ, code 230 */,
	2948 /* ç, code 231 */,
	2966 /* è, code 232 */,
	2984 /* é, code 233 */,
	3002 /* ê, code 234 */,
	3020 /* ë, code 235 */,
	3038 /* ì, code 236 */,
	3050 /* í, code 237 */,
	3062 /* î, code 238 */,
	3074 /* ï, code 239 */,
	3086 /* ð, code 240 */,
	3106 /* ñ, code 241 */,
	3128 /* ò, code 242 */,
	3148 /* ó, code 243 */,
	3168 /* ô, code 244 */,
	3188 /* õ, code 245 */,
	3208 /* ö, code 246 */,
	3228 /* ÷, code 247 */,
	3246 /* ø, code 248 */,
	3266 /* ù, code 249 */,
	3288 /* ú, code 250 */,
	3310 /* û, code 251 */,
	3332 /* ü, code 252 */,
	3354 /* ý, code 253 */,
	3374 /* þ, code 254 */,
	3394 /* ÿ, code 255 */,
	3414 /* ?, code 256 */,
};
