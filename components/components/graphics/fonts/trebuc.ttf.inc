/* THIS FILE IS AUTO-GENERATED BY THE CLOWNFISH SSD1306Converter TOOL!                 */
/* DON'T MODIFY IT BY HAND SINCE IT CAN GET REPLACED AUTOMATICALLY.                    */

/* The generated code is a font or image for the SSD1306Driver. */
/* generation date: Wed Dec 22 21:52:21 CET 2021 */

/* *** Font >Trebuchet MS< *** */
#define SSD1306_FONT_Trebuchet_MS_16_CHARACTERCOUNT			256

static const uint8_t gFont_Trebuchet_MS_16_Characters[] = {
	0x0, 0xc0, 0x40, 0x40, 0x40, 0xc0, 0x0, 0x0, 0x7, 0x4, 0x4, 0x4, 0x7, 0x0, 	// character, code 0
		// character, code 1
		// character, code 2
		// character, code 3
		// character, code 4
		// character, code 5
		// character, code 6
		// character, code 7
		// character, code 8
	0x0, 0x0, 	// character, code 9
	0x0, 0x0, 	// character, code 10
		// character, code 11
		// character, code 12
	0x0, 0x0, 	// character, code 13
		// character, code 14
		// character, code 15
		// character, code 16
		// character, code 17
		// character, code 18
		// character, code 19
		// character, code 20
		// character, code 21
		// character, code 22
		// character, code 23
		// character, code 24
		// character, code 25
		// character, code 26
		// character, code 27
		// character, code 28
		// character, code 29
		// character, code 30
		// character, code 31
	0x0, 0x0, 0x0, 0x0, 0x0, 0x0, 0x0, 0x0, 	// character, code 32
	0x0, 0x0, 0xf8, 0x0, 0x0, 0x0, 0x0, 0x1b, 0x0, 0x0, 	// character, code 33
	0x0, 0x78, 0x0, 0x78, 0x0, 0x0, 0x0, 0x0, 0x0, 0x0, 	// character, code 34
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	0x0, 0x80, 0x80, 0x0, 0x0, 0x80, 0x0, 0x0, 0x1, 0x0, 0x1, 0x1, 0x1, 0x0, 	// character ~, code 126
		// character , code 127
		// character ?, code 128
		// character ?, code 129
		// character ?, code 130
		// character ?, code 131
		// character ?, code 132
		// character ?, code 133
		// character ?, code 134
		// character ?, code 135
		// character ?, code 136
		// character ?, code 137
		// character ?, code 138
		// character ?, code 139
		// character ?, code 140
		// character ?, code 141
		// character ?, code 142
		// character ?, code 143
		// character ?, code 144
		// character ?, code 145
		// character ?, code 146
		// character ?, code 147
		// character ?, code 148
		// character ?, code 149
		// character ?, code 150
		// character ?, code 151
		// character ?, code 152
		// character ?, code 153
		// character ?, code 154
		// character ?, code 155
		// character ?, code 156
		// character ?, code 157
		// character ?, code 158
		// character ?, code 159
	0x0, 0x0, 0x0, 0x0, 0x0, 0x0, 0x0, 0x0, 	// character  , code 160
	0x0, 0x0, 0xc0, 0x0, 0x0, 0x0, 0x0, 0xfe, 0x0, 0x0, 	// character ¡, code 161
	0x0, 0x80, 0xc0, 0x40, 0xe0, 0x50, 0x0, 0x0, 0x7, 0x3c, 0xe, 0x9, 0x8, 0x0, 	// character ¢, code 162
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	0x40, 0x8c, 0xc, 0x0, 0x0, 0x8c, 0x4c, 0x0, 0x83, 0x9c, 0x60, 0x1c, 0x3, 0x0, 	// character ÿ, code 255
};

static const uint16_t gFont_Trebuchet_MS_16_CharacterOffsets[] = {
	0 /* code 0 */,
	14 /* code 1 */,
	14 /* code 2 */,
	14 /* code 3 */,
	14 /* code 4 */,
	14 /* code 5 */,
	14 /* code 6 */,
	14 /* code 7 */,
	14 /* code 8 */,
	14 /* code 9 */,
	16 /* code 10 */,
	18 /* code 11 */,
	18 /* code 12 */,
	18 /* code 13 */,
	20 /* code 14 */,
	20 /* code 15 */,
	20 /* code 16 */,
	20 /* code 17 */,
	20 /* code 18 */,
	20 /* code 19 */,
	20 /* code 20 */,
	20 /* code 21 */,
	20 /* code 22 */,
	20 /* code 23 */,
	20 /* code 24 */,
	20 /* code 25 */,
	20 /* code 26 */,
	20 /* code 27 */,
	20 /* code 28 */,
	20 /* code 29 */,
	20 /* code 30 */,
	20 /* code 31 */,
	20 /* code 32 */,
	28 /* code 33 */,
	38 /* code 34 */,
	48 /* #, code 35 */,
	62 /* $, code 36 */,
	76 /* %, code 37 */,
	92 /* &, code 38 */,
	112 /* ', code 39 */,
	116 /* (, code 40 */,
	126 /* ), code 41 */,
	136 /* *, code 42 */,
	146 /* +, code 43 */,
	160 /* ,, code 44 */,
	170 /* -, code 45 */,
	180 /* ., code 46 */,
	190 /* /, code 47 */,
	204 /* 0, code 48 */,
	218 /* 1, code 49 */,
	232 /* 2, code 50 */,
	246 /* 3, code 51 */,
	260 /* 4, code 52 */,
	274 /* 5, code 53 */,
	288 /* 6, code 54 */,
	302 /* 7, code 55 */,
	316 /* 8, code 56 */,
	330 /* 9, code 57 */,
	344 /* :, code 58 */,
	354 /* ;, code 59 */,
	364 /* <, code 60 */,
	378 /* =, code 61 */,
	392 /* >, code 62 */,
	406 /* ?, code 63 */,
	416 /* @, code 64 */,
	438 /* A, code 65 */,
	456 /* B, code 66 */,
	472 /* C, code 67 */,
	488 /* D, code 68 */,
	506 /* E, code 69 */,
	522 /* F, code 70 */,
	536 /* G, code 71 */,
	554 /* H, code 72 */,
	572 /* I, code 73 */,
	580 /* J, code 74 */,
	594 /* K, code 75 */,
	610 /* L, code 76 */,
	624 /* M, code 77 */,
	646 /* N, code 78 */,
	664 /* O, code 79 */,
	682 /* P, code 80 */,
	698 /* Q, code 81 */,
	718 /* R, code 82 */,
	734 /* S, code 83 */,
	748 /* T, code 84 */,
	764 /* U, code 85 */,
	782 /* V, code 86 */,
	800 /* W, code 87 */,
	824 /* X, code 88 */,
	840 /* Y, code 89 */,
	854 /* Z, code 90 */,
	870 /* [, code 91 */,
	880 /* \, code 92 */,
	890 /* ], code 93 */,
	900 /* ^, code 94 */,
	914 /* _, code 95 */,
	928 /* `, code 96 */,
	942 /* a, code 97 */,
	956 /* b, code 98 */,
	972 /* c, code 99 */,
	986 /* d, code 100 */,
	1002 /* e, code 101 */,
	1018 /* f, code 102 */,
	1028 /* g, code 103 */,
	1042 /* h, code 104 */,
	1058 /* i, code 105 */,
	1066 /* j, code 106 */,
	1076 /* k, code 107 */,
	1090 /* l, code 108 */,
	1096 /* m, code 109 */,
	1118 /* n, code 110 */,
	1134 /* o, code 111 */,
	1150 /* p, code 112 */,
	1166 /* q, code 113 */,
	1182 /* r, code 114 */,
	1192 /* s, code 115 */,
	1204 /* t, code 116 */,
	1216 /* u, code 117 */,
	1232 /* v, code 118 */,
	1246 /* w, code 119 */,
	1268 /* x, code 120 */,
	1282 /* y, code 121 */,
	1296 /* z, code 122 */,
	1310 /* {, code 123 */,
	1320 /* |, code 124 */,
	1334 /* }, code 125 */,
	1344 /* ~, code 126 */,
	1358 /* , code 127 */,
	1358 /* ?, code 128 */,
	1358 /* ?, code 129 */,
	1358 /* ?, code 130 */,
	1358 /* ?, code 131 */,
	1358 /* ?, code 132 */,
	1358 /* ?, code 133 */,
	1358 /* ?, code 134 */,
	1358 /* ?, code 135 */,
	1358 /* ?, code 136 */,
	1358 /* ?, code 137 */,
	1358 /* ?, code 138 */,
	1358 /* ?, code 139 */,
	1358 /* ?, code 140 */,
	1358 /* ?, code 141 */,
	1358 /* ?, code 142 */,
	1358 /* ?, code 143 */,
	1358 /* ?, code 144 */,
	1358 /* ?, code 145 */,
	1358 /* ?, code 146 */,
	1358 /* ?, code 147 */,
	1358 /* ?, code 148 */,
	1358 /* ?, code 149 */,
	1358 /* ?, code 150 */,
	1358 /* ?, code 151 */,
	1358 /* ?, code 152 */,
	1358 /* ?, code 153 */,
	1358 /* ?, code 154 */,
	1358 /* ?, code 155 */,
	1358 /* ?, code 156 */,
	1358 /* ?, code 157 */,
	1358 /* ?, code 158 */,
	1358 /* ?, code 159 */,
	1358 /*  , code 160 */,
	1366 /* ¡, code 161 */,
	1376 /* ¢, code 162 */,
	1390 /* £, code 163 */,
	1404 /* ¤, code 164 */,
	1418 /* ¥, code 165 */,
	1432 /* ¦, code 166 */,
	1446 /* §, code 167 */,
	1458 /* ¨, code 168 */,
	1472 /* ©, code 169 */,
	1492 /* ª, code 170 */,
	1502 /* «, code 171 */,
	1516 /* ¬, code 172 */,
	1530 /* ­, code 173 */,
	1540 /* ®, code 174 */,
	1560 /* ¯, code 175 */,
	1574 /* °, code 176 */,
	1588 /* ±, code 177 */,
	1602 /* ², code 178 */,
	1614 /* ³, code 179 */,
	1626 /* ´, code 180 */,
	1640 /* µ, code 181 */,
	1656 /* ¶, code 182 */,
	1670 /* ·, code 183 */,
	1680 /* ¸, code 184 */,
	1694 /* ¹, code 185 */,
	1706 /* º, code 186 */,
	1716 /* », code 187 */,
	1730 /* ¼, code 188 */,
	1752 /* ½, code 189 */,
	1774 /* ¾, code 190 */,
	1796 /* ¿, code 191 */,
	1806 /* À, code 192 */,
	1824 /* Á, code 193 */,
	1842 /* Â, code 194 */,
	1860 /* Ã, code 195 */,
	1878 /* Ä, code 196 */,
	1896 /* Å, code 197 */,
	1914 /* Æ, code 198 */,
	1938 /* Ç, code 199 */,
	1954 /* È, code 200 */,
	1970 /* É, code 201 */,
	1986 /* Ê, code 202 */,
	2002 /* Ë, code 203 */,
	2018 /* Ì, code 204 */,
	2026 /* Í, code 205 */,
	2034 /* Î, code 206 */,
	2042 /* Ï, code 207 */,
	2050 /* Ð, code 208 */,
	2068 /* Ñ, code 209 */,
	2086 /* Ò, code 210 */,
	2104 /* Ó, code 211 */,
	2122 /* Ô, code 212 */,
	2140 /* Õ, code 213 */,
	2158 /* Ö, code 214 */,
	2176 /* ×, code 215 */,
	2190 /* Ø, code 216 */,
	2208 /* Ù, code 217 */,
	2226 /* Ú, code 218 */,
	2244 /* Û, code 219 */,
	2262 /* Ü, code 220 */,
	2280 /* Ý, code 221 */,
	2294 /* Þ, code 222 */,
	2310 /* ß, code 223 */,
	2326 /* à, code 224 */,
	2340 /* á, code 225 */,
	2354 /* â, code 226 */,
	2368 /* ã, code 227 */,
	2382 /* ä, code 228 */,
	2396 /* å, code 229 */,
	2410 /* æ, code 230 */,
	2434 /* ç, code 231 */,
	2448 /* è, code 232 */,
	2464 /* é, code 233 */,
	2480 /* ê, code 234 */,
	2496 /* ë, code 235 */,
	2512 /* ì, code 236 */,
	2520 /* í, code 237 */,
	2528 /* î, code 238 */,
	2536 /* ï, code 239 */,
	2544 /* ð, code 240 */,
	2560 /* ñ, code 241 */,
	2576 /* ò, code 242 */,
	2592 /* ó, code 243 */,
	2608 /* ô, code 244 */,
	2624 /* õ, code 245 */,
	2640 /* ö, code 246 */,
	2656 /* ÷, code 247 */,
	2670 /* ø, code 248 */,
	2686 /* ù, code 249 */,
	2702 /* ú, code 250 */,
	2718 /* û, code 251 */,
	2734 /* ü, code 252 */,
	2750 /* ý, code 253 */,
	2764 /* þ, code 254 */,
	2780 /* ÿ, code 255 */,
	2794 /* ?, code 256 */,
};
