/* THIS FILE IS AUTO-GENERATED BY THE CLOWNFISH SSD1306Converter TOOL!                 */
/* DON'T MODIFY IT BY HAND SINCE IT CAN GET REPLACED AUTOMATICALLY.                    */

/* The generated code is a font or image for the SSD1306Driver. */
/* generation date: Wed Dec 22 21:55:23 CET 2021 */

/* *** Font >SketchFlow Print< *** */
#define SSD1306_FONT_SketchFlow_Print_16_CHARACTERCOUNT			256

static const uint8_t gFont_SketchFlow_Print_16_Characters[] = {
	0x0, 0x0, 0x0, 0x0, 0x0, 0x0, 0x0, 0x0, 0x0, 0x0, 0x0, 0x0, 0x0, 0x0, 	// character, code 0
		// character, code 1
		// character, code 2
		// character, code 3
		// character, code 4
		// character, code 5
		// character, code 6
		// character, code 7
		// character, code 8
	0x0, 0x0, 	// character, code 9
	0x0, 0x0, 	// character, code 10
		// character, code 11
		// character, code 12
	0x0, 0x0, 	// character, code 13
		// character, code 14
		// character, code 15
		// character, code 16
		// character, code 17
		// character, code 18
		// character, code 19
		// character, code 20
		// character, code 21
		// character, code 22
		// character, code 23
		// character, code 24
		// character, code 25
		// character, code 26
		// character, code 27
		// character, code 28
		// character, code 29
		// character, code 30
		// character, code 31
		// character, code 32
	0x0, 0x0, 0x0, 0xfc, 0x0, 0x0, 0x0, 0x0, 0xa, 0xd, 0x0, 0x0, 	// character, code 33
	0x0, 0x24, 0x1a, 0xc, 0x0, 0x0, 0x0, 0x0, 0x0, 0x0, 	// character, code 34
	0x0, 0x80, 0x80, 0x80, 0xf8, 0x40, 0x40, 0xfc, 0x40, 0x40, 0x40, 0x80, 0x5, 0x4, 0x4, 0x6, 0x3f, 0x2, 0x2, 0xf, 0x1, 0x1, 0x1, 0x0, 	// character #, code 35
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	0x0, 0x80, 0x40, 0x40, 0xc0, 0x80, 0x80, 0x40, 0x20, 0x0, 0x1, 0x0, 0x0, 0x0, 0x0, 0x0, 0x0, 0x0, 	// character ~, code 126
		// character , code 127
		// character ?, code 128
		// character ?, code 129
		// character ?, code 130
		// character ?, code 131
		// character ?, code 132
		// character ?, code 133
		// character ?, code 134
		// character ?, code 135
		// character ?, code 136
		// character ?, code 137
		// character ?, code 138
		// character ?, code 139
		// character ?, code 140
		// character ?, code 141
		// character ?, code 142
		// character ?, code 143
		// character ?, code 144
		// character ?, code 145
		// character ?, code 146
		// character ?, code 147
		// character ?, code 148
		// character ?, code 149
		// character ?, code 150
		// character ?, code 151
		// character ?, code 152
		// character ?, code 153
		// character ?, code 154
		// character ?, code 155
		// character ?, code 156
		// character ?, code 157
		// character ?, code 158
		// character ?, code 159
		// character  , code 160
	0x0, 0x0, 0x60, 0x20, 0x0, 0x0, 0x0, 0x0, 0x7f, 0x0, 0x0, 0x0, 	// character ¡, code 161
	0x0, 0xc0, 0x60, 0xfc, 0x10, 0x10, 0x8, 0x80, 0x7, 0x4, 0x4, 0x1f, 0x2, 0x2, 0x1, 0x0, 	// character ¢, code 162
	0x0, 0x80, 0x80, 0xf0, 0x88, 0x84, 0x9c, 0x80, 0x40, 0x0, 0x0, 0x10, 0x8, 0x6, 0x5, 0x4, 0x8, 0x8, 0x8, 0x8, 0x4, 0x0, 	// character £, code 163
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	0x40, 0x80, 0x4, 0x0, 0x0, 0x84, 0x60, 0x80, 0x81, 0x63, 0x1c, 0x6, 0x1, 0x0, 	// character ÿ, code 255
};

static const uint16_t gFont_SketchFlow_Print_16_CharacterOffsets[] = {
	0 /* code 0 */,
	14 /* code 1 */,
	14 /* code 2 */,
	14 /* code 3 */,
	14 /* code 4 */,
	14 /* code 5 */,
	14 /* code 6 */,
	14 /* code 7 */,
	14 /* code 8 */,
	14 /* code 9 */,
	16 /* code 10 */,
	18 /* code 11 */,
	18 /* code 12 */,
	18 /* code 13 */,
	20 /* code 14 */,
	20 /* code 15 */,
	20 /* code 16 */,
	20 /* code 17 */,
	20 /* code 18 */,
	20 /* code 19 */,
	20 /* code 20 */,
	20 /* code 21 */,
	20 /* code 22 */,
	20 /* code 23 */,
	20 /* code 24 */,
	20 /* code 25 */,
	20 /* code 26 */,
	20 /* code 27 */,
	20 /* code 28 */,
	20 /* code 29 */,
	20 /* code 30 */,
	20 /* code 31 */,
	20 /* code 32 */,
	20 /* code 33 */,
	32 /* code 34 */,
	42 /* #, code 35 */,
	66 /* $, code 36 */,
	88 /* %, code 37 */,
	114 /* &, code 38 */,
	134 /* ', code 39 */,
	142 /* (, code 40 */,
	158 /* ), code 41 */,
	174 /* *, code 42 */,
	188 /* +, code 43 */,
	208 /* ,, code 44 */,
	218 /* -, code 45 */,
	232 /* ., code 46 */,
	244 /* /, code 47 */,
	256 /* 0, code 48 */,
	274 /* 1, code 49 */,
	284 /* 2, code 50 */,
	304 /* 3, code 51 */,
	324 /* 4, code 52 */,
	346 /* 5, code 53 */,
	368 /* 6, code 54 */,
	388 /* 7, code 55 */,
	408 /* 8, code 56 */,
	428 /* 9, code 57 */,
	448 /* :, code 58 */,
	462 /* ;, code 59 */,
	476 /* <, code 60 */,
	494 /* =, code 61 */,
	512 /* >, code 62 */,
	530 /* ?, code 63 */,
	546 /* @, code 64 */,
	574 /* A, code 65 */,
	594 /* B, code 66 */,
	620 /* C, code 67 */,
	640 /* D, code 68 */,
	664 /* E, code 69 */,
	686 /* F, code 70 */,
	704 /* G, code 71 */,
	726 /* H, code 72 */,
	746 /* I, code 73 */,
	754 /* J, code 74 */,
	770 /* K, code 75 */,
	792 /* L, code 76 */,
	808 /* M, code 77 */,
	832 /* N, code 78 */,
	854 /* O, code 79 */,
	874 /* P, code 80 */,
	894 /* Q, code 81 */,
	918 /* R, code 82 */,
	936 /* S, code 83 */,
	958 /* T, code 84 */,
	976 /* U, code 85 */,
	998 /* V, code 86 */,
	1016 /* W, code 87 */,
	1046 /* X, code 88 */,
	1064 /* Y, code 89 */,
	1084 /* Z, code 90 */,
	1110 /* [, code 91 */,
	1128 /* \, code 92 */,
	1144 /* ], code 93 */,
	1162 /* ^, code 94 */,
	1174 /* _, code 95 */,
	1192 /* `, code 96 */,
	1208 /* a, code 97 */,
	1228 /* b, code 98 */,
	1246 /* c, code 99 */,
	1262 /* d, code 100 */,
	1284 /* e, code 101 */,
	1300 /* f, code 102 */,
	1312 /* g, code 103 */,
	1328 /* h, code 104 */,
	1346 /* i, code 105 */,
	1354 /* j, code 106 */,
	1362 /* k, code 107 */,
	1376 /* l, code 108 */,
	1384 /* m, code 109 */,
	1408 /* n, code 110 */,
	1426 /* o, code 111 */,
	1444 /* p, code 112 */,
	1466 /* q, code 113 */,
	1486 /* r, code 114 */,
	1506 /* s, code 115 */,
	1524 /* t, code 116 */,
	1536 /* u, code 117 */,
	1552 /* v, code 118 */,
	1564 /* w, code 119 */,
	1586 /* x, code 120 */,
	1600 /* y, code 121 */,
	1614 /* z, code 122 */,
	1632 /* {, code 123 */,
	1648 /* |, code 124 */,
	1656 /* }, code 125 */,
	1672 /* ~, code 126 */,
	1690 /* , code 127 */,
	1690 /* ?, code 128 */,
	1690 /* ?, code 129 */,
	1690 /* ?, code 130 */,
	1690 /* ?, code 131 */,
	1690 /* ?, code 132 */,
	1690 /* ?, code 133 */,
	1690 /* ?, code 134 */,
	1690 /* ?, code 135 */,
	1690 /* ?, code 136 */,
	1690 /* ?, code 137 */,
	1690 /* ?, code 138 */,
	1690 /* ?, code 139 */,
	1690 /* ?, code 140 */,
	1690 /* ?, code 141 */,
	1690 /* ?, code 142 */,
	1690 /* ?, code 143 */,
	1690 /* ?, code 144 */,
	1690 /* ?, code 145 */,
	1690 /* ?, code 146 */,
	1690 /* ?, code 147 */,
	1690 /* ?, code 148 */,
	1690 /* ?, code 149 */,
	1690 /* ?, code 150 */,
	1690 /* ?, code 151 */,
	1690 /* ?, code 152 */,
	1690 /* ?, code 153 */,
	1690 /* ?, code 154 */,
	1690 /* ?, code 155 */,
	1690 /* ?, code 156 */,
	1690 /* ?, code 157 */,
	1690 /* ?, code 158 */,
	1690 /* ?, code 159 */,
	1690 /*  , code 160 */,
	1690 /* ¡, code 161 */,
	1702 /* ¢, code 162 */,
	1718 /* £, code 163 */,
	1740 /* ¤, code 164 */,
	1758 /* ¥, code 165 */,
	1778 /* ¦, code 166 */,
	1786 /* §, code 167 */,
	1802 /* ¨, code 168 */,
	1818 /* ©, code 169 */,
	1842 /* ª, code 170 */,
	1856 /* «, code 171 */,
	1874 /* ¬, code 172 */,
	1892 /* ­, code 173 */,
	1906 /* ®, code 174 */,
	1930 /* ¯, code 175 */,
	1946 /* °, code 176 */,
	1962 /* ±, code 177 */,
	1982 /* ², code 178 */,
	1996 /* ³, code 179 */,
	2010 /* ´, code 180 */,
	2026 /* µ, code 181 */,
	2044 /* ¶, code 182 */,
	2064 /* ·, code 183 */,
	2078 /* ¸, code 184 */,
	2094 /* ¹, code 185 */,
	2102 /* º, code 186 */,
	2114 /* », code 187 */,
	2134 /* ¼, code 188 */,
	2158 /* ½, code 189 */,
	2182 /* ¾, code 190 */,
	2212 /* ¿, code 191 */,
	2228 /* À, code 192 */,
	2248 /* Á, code 193 */,
	2268 /* Â, code 194 */,
	2288 /* Ã, code 195 */,
	2308 /* Ä, code 196 */,
	2328 /* Å, code 197 */,
	2348 /* Æ, code 198 */,
	2378 /* Ç, code 199 */,
	2398 /* È, code 200 */,
	2420 /* É, code 201 */,
	2442 /* Ê, code 202 */,
	2464 /* Ë, code 203 */,
	2486 /* Ì, code 204 */,
	2494 /* Í, code 205 */,
	2502 /* Î, code 206 */,
	2510 /* Ï, code 207 */,
	2518 /* Ð, code 208 */,
	2542 /* Ñ, code 209 */,
	2564 /* Ò, code 210 */,
	2584 /* Ó, code 211 */,
	2604 /* Ô, code 212 */,
	2624 /* Õ, code 213 */,
	2644 /* Ö, code 214 */,
	2664 /* ×, code 215 */,
	2678 /* Ø, code 216 */,
	2698 /* Ù, code 217 */,
	2720 /* Ú, code 218 */,
	2742 /* Û, code 219 */,
	2764 /* Ü, code 220 */,
	2786 /* Ý, code 221 */,
	2806 /* Þ, code 222 */,
	2826 /* ß, code 223 */,
	2848 /* à, code 224 */,
	2868 /* á, code 225 */,
	2888 /* â, code 226 */,
	2908 /* ã, code 227 */,
	2928 /* ä, code 228 */,
	2948 /* å, code 229 */,
	2968 /* æ, code 230 */,
	2996 /* ç, code 231 */,
	3012 /* è, code 232 */,
	3028 /* é, code 233 */,
	3044 /* ê, code 234 */,
	3060 /* ë, code 235 */,
	3076 /* ì, code 236 */,
	3084 /* í, code 237 */,
	3092 /* î, code 238 */,
	3100 /* ï, code 239 */,
	3108 /* ð, code 240 */,
	3126 /* ñ, code 241 */,
	3144 /* ò, code 242 */,
	3162 /* ó, code 243 */,
	3180 /* ô, code 244 */,
	3198 /* õ, code 245 */,
	3216 /* ö, code 246 */,
	3234 /* ÷, code 247 */,
	3250 /* ø, code 248 */,
	3268 /* ù, code 249 */,
	3284 /* ú, code 250 */,
	3300 /* û, code 251 */,
	3316 /* ü, code 252 */,
	3332 /* ý, code 253 */,
	3346 /* þ, code 254 */,
	3370 /* ÿ, code 255 */,
	3384 /* ?, code 256 */,
};
