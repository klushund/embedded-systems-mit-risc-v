## components/components/graphics/Kconfig.projbuild
```kconfig
menu "Graphics Configuration"
	
	config GRAPHICS_I2CADDR
		int "i2c address"
		default 60
		help
			I2C Address of the SSD1306 display controller
	
	config GRAPHICS_BITSPERPIXEL
		int "bits per pixel"
		default 1
		help
			Currently only monochrome displays are supported (i.e. value 1)
			
    config GRAPHICS_PIXELWIDTH
        int "Pixel Width"
        default 128
        help
            Width of monochrome display in pixels.

    config GRAPHICS_PIXELHEIGHT
        int "Pixel Width"
        default 64
        help
            Width of monochrome display in pixels.
	
	menu "Fonts"
		config GRAPHICS_USE_FONT_SKETCHFLOW_PRINT
			bool "Use Font 'SketchFlow_Print'"
			default y
			help
				Mark to make the font available.

		config GRAPHICS_USE_FONT_STENCIL
			bool "Use Font 'Stencil'"
			default y
			help
				Mark to make the font available.
						
		config GRAPHICS_USE_FONT_TREBUCHET_MS
			bool "Use Font 'Trebuchet MS'"
			default y
			help
				Mark to make the font available.
				
		choice
            prompt "Default Font"
            default GRAPHICS_DEFAULT_FONT_Trebuchet_MS
            help
                Default font to be used.

            config GRAPHICS_DEFAULT_FONT_SKETCHFLOW_PRINT
                bool "SketchFlow Print"
            config GRAPHICS_DEFAULT_FONT_STENCIL
                bool "Stencil"
            config GRAPHICS_DEFAULT_FONT_TREBUCHET_MS
                bool "Trebuchet MS"
        endchoice
			
	endmenu
	
endmenu
```

## components/components/pushbtn/Kconfig.projbuild
```kconfig
menu "Button Configuration"
	
	config BUTTON_GPIO
		int "GPIO used for button"
		default 9
		help
			On the ESP32-C3-DevKitM-1 the boot button is on GPIO 9. 
			
endmenu
```

## gameoflife/main/Kconfig.projbuild
```kconfig
menu "gameoflife Configuration"
choice INITIALIZE_GAMEFIELD
	prompt "gamefield initialization"
	default INITIALIZE_GAMEFIELD_RANDOM
	help
		Select the method to initialize the game field upon reset
		
	config INITIALIZE_GAMEFIELD_RANDOM
		bool "Random gamefield initialization"
		help
			Initializes the gamefield with random cells
			
	config INITIALIZE_GAMEFIELD_OSCILLATING
		bool "Oscillating gamefield initialization"
		help
			Initializes the gamefield with an oscillating object

	config INITIALIZE_GAMEFIELD_GLIDER
		bool "Glider gamefield initialization"
		help
			Initializes the gamefield with a glider object
endchoice			
endmenu
```

## histogram/main/Kconfig.projbuild
```kconfig
menu "Histogram Cachetest Configuration"
	config TESTSIZE_KiB
    	int "TESTSIZE_KiB"
    	default 1
    	help
			Size of the test, in KiB

	choice MEASUREMENT_TYPE
        prompt "Type of Measurement"
        default MEASURE_CYCLES
        help
            Select the type of measurement
        config MEASURE_CYCLES
            bool "Measure executed clock cycles"
        config MEASURE_INSTRUCTIONS
            bool "Measure executed instructions"
    endchoice
endmenu
```

## interrupt_demo/main/Kconfig.projbuild
```kconfig
menu "interrupt_demo Configuration"
	config LED1_GPIO
		int "LED1 GPIO"
		default 4
		help
			GPIO LED1 is connected to. In the book it is 4, the book development board uses 0
			
	config BUTTON_GPIO
		int "Button GPIO"
		default 6
		help
			GPIO the Button is connected to. In the book it is 6, the book development board uses 9

	choice CALLBACK_TYPE
        prompt "Type of Callback"
        default CALLBACK_DYNAMIC
        help
            Select the type of callback: none, static, or dynamic
        config CALLBACK_NONE
            bool "No callback (use global variable)"
        config CALLBACK_STATIC
            bool "Static callback"
        config CALLBACK_DYNAMIC
        	bool "Dynamic callback"
    endchoice
endmenu
```

## leds_and_button/main/Kconfig.projbuild
```kconfig
menu "leds_and_button Configuration"
	config LED1_GPIO
		int "LED1 GPIO"
		default 4
		help
			GPIO LED1 is connected to. In the book it is 4, the book development board uses 0
			
	config LED2_GPIO
		int "LED2 GPIO"
		default 5
		help
			GPIO LED2 is connected to. In the book it is 5, the book development board uses 1

	config BUTTON_GPIO
		int "Button GPIO"
		default 6
		help
			GPIO the Button is connected to. In the book it is 6, the book development board uses 9
endmenu
```

## motiondetect/main/Kconfig.projbuild
```kconfig
menu "motiondetect Configuration"
config LEDSTRIP_GPIO
    int "LED strip GPIO"
    default 8
    help
	The GPIO the LED strip signal line is connected to.

config PIRSENSOR_GPIO
    int "PIR Sensor GPIO"
    default 3
    help
	The GPIO the PIR sensor signal line is connected to.
	
config PIR_LED_ACTIVATION_s
	int "PIR LED Activation"
	default 5
	help
	LED activation due to PIR activity, in seconds

config LED_DARK_VALUE
	int "Value for dark LED"
	default 1
	help
	The brightness the dark LED is turned on with
	
config LED_LITUP_VALUE
	int "Value for lit-up LED"
	default 20
	help
	The brightness the lit-up LED is turned on with

endmenu
```

## poxi/main/Kconfig.projbuild
```kconfig
menu "Poxi Configuration"
    config USE_PROVISIONING
        bool
        default n
        prompt "Use provisioning (Y) or provide a static IP (N)"
        help
            If enabled, use provisioning with the mobile phone app. Otherwise provide a static IP address

	menu "Static WIFI Configuration"
		depends on !USE_PROVISIONING

		config WIFI_SSID
		    string "WiFi SSID"
		    default "myssid"
		    help
			SSID (network name) for the example to connect to.
		
		config WIFI_PASSWORD
		    string "WiFi Password"
		    default "mypassword"
		    help
			WiFi password (WPA or WPA2) for the example to use.

	endmenu
	
	menu "Provisioning Configuration"
		depends on USE_PROVISIONING
		
    	config RESET_PROVISIONED
        	bool
        	default n
        	prompt "Reset provisioned status of the device"
        	help
            	This erases the NVS to reset provisioned status of the device on every reboot.
            	Provisioned status is determined by the Wi-Fi STA configuration, saved on the NVS.

    	config RESET_PROV_MGR_ON_FAILURE
        	bool
        	default y
        	prompt "Reset provisioned credentials and state machine after session failure"
        	help
            	Enable reseting provisioned credentials and state machine after session failure.
            	This will restart the provisioning service after retries are exhausted.

    	config PROV_MGR_MAX_RETRY_CNT
        	int
        	default 5
        	prompt "Max retries before reseting provisioning state machine"
        	depends on RESET_PROV_MGR_ON_FAILURE
        	help
            	Set the Maximum retry to avoid reconnecting to an inexistent AP or if credentials
            	are misconfigured. Provisioned credentials are erased and internal state machine
            	is reset after this threshold is reached.

    	config PROV_SHOW_QR
        	bool "Show provisioning QR code"
        	default y
        	help
            	Show the QR code for provisioning.

	endmenu
	
	menu "MQTT Configuration"
	
		config MQTT_BROKER_URL
			string "MQTT Broker URL"
			default "mqtt://test.mosquitto.org"
			help
			URL of the MQTT Broker used to send pulse data on Key Press
			
		config MQTT_BROKER_USERNAME
			string "MQTT user name"
			default ""
			help
			User name for MQTT broker login

		config MQTT_BROKER_PASSWORD
			string "MQTT password"
			default ""
			help
			Password for MQTT broker login
			
		config MQTT_TOPIC
			string "MQTT Topic"
			default "poxi/bpm"
			help
			MQTT Topic used to send the pulse data

	endmenu
	
	menu "Remote Connection Configuration"
	
	    config IPV4_ADDR
	        string "IPV4 Address"
	        default "127.0.0.1"
	        help
	            IPV4 address to which the client example will send data.
	
	    config PORT
	        int "Port"
	        range 0 65535
	        default 15651
	        help
	            The remote port to which the client example will send data.
	
	    choice TRANSPORT_LAYER
	        prompt "Transport Layer"
	        default TRANSPORT_UDP
	        help
	            Selects the transport layer protocol.
	
	        config TRANSPORT_UDP
	            bool "send over UDP"
	
	        config TRANSPORT_TCP
	            bool "send over TCP"
	    endchoice
	
	endmenu	

	config START_WEBSERVER
        bool
        default y
        prompt "Start the internal webserver"
        help
            The internal webserver can privide pulse information in standard port 80
         
endmenu
```

## rng_test/main/Kconfig.projbuild
```kconfig
menu "rng_test Configuration"
	config M
	    int "m, number of chi square bins"
	    default 10
	    help
		Enter the number of chi square bins, m. Typically 10.
	
	config OBSERVATIONS
	    int "Number of observations"
	    default 100
	    help
		The number of observations is the number of drawn random numbers.
	
	choice MODULO_CALCULATION
	    prompt "Type of modulo calculation"
	    default CALCULATE_MOD_M
	    help
	        Select the type of modulo calculation
	    config CALCULATE_MOD_M
	        bool "nextRand() % m"
	    config CALCULATE_BYTE_MOD_M
	        bool "(nextRand() & 0xFF) % m"
	    config CALCULATE_NIBBLE_MOD_M
	        bool "(nextRand() & 0x0F) % m"
    endchoice
endmenu
```

## servocontrol/main/Kconfig.projbuild
```kconfig
menu "servocontrol Configuration"
choice USE_FILTER
	prompt "use filter for servo control"
	default USE_FIR2_FILTER
	help
		Select the filter to use for LED and servo control
		
	config USE_FIR2_FILTER
		bool "Use FIR Filter order 2"
		help
			Use FIR Filter order 2 with parameters ( 0.5, 0.5 )
			
	config USE_FIR10_FILTER
		bool "Use FIR Filter order 10"
		help
			Use IIR Filter order 10 with parameters (0.1, 0.1, 0.1, 0.1, 0.1, 0.1, 0.1, 0.1, 0.1, 0.1)

	config USE_IIR_FILTER
		bool "Use IIR Filter"
		help
			Use IIR Filter with parameters (0.4142, 0.0, 0.2929, 0.2929, 0.0)
endchoice		
endmenu
```

## sum_up_n_measurements/main/Kconfig.projbuild
```kconfig
menu "sum_up_n Measurements Configuration"
	config USE_CSR_MACROS
    	bool "Use CSR Macros"
    	default false
    	help
			Use the CSR Macros from ESP-IDF instead of inline assembly

	config CALCULATE_IN_FUNCTION
    	bool "Calculate in function"
    	default false
    	help
			Calculate the sum in a function (true) or inline (false)

	config USE_ASSEMBLER_FUNCTION
    	bool "Use Assembler function"
    	default false
    	depends on CALCULATE_IN_FUNCTION
    	help
			Use the C-Function sum_up_n() or the assembler function sum_up_func()

	config USE_CONSTANT_TEST_VALUE
		int "Use constant test value"
		default 100
		help
			Use the same input value for all tests, e.g. 100.
			If set to 0, the values 1, 1, 10, 100, 1000, 10000, 100000, 1000000 will be used in separate runs
			
	config USE_LOOP
		bool "Calculate in a loop"
		default false
		help
			Calculate more than once, in a loop.
			The input values are defined in USE_CONSTANT_TEST_VALUE.
			
	choice USE_GAUSS_FORMULA
        prompt "Type of formula"
        default MEASURE_CYCLES
        help
            Select the type of formula for calculation 
        config GAUSS_FORMULA_1
            bool "(upperNumber * (upperNumber + 1)) / 2"
        config GAUSS_FORMULA_2
            bool "((upperNumber * upperNumber) + upperNumber) / 2"
        config GAUSS_FORMULA_LOOP
        	bool "loop calculation"
    endchoice
endmenu
```

## switch_led/main/Kconfig.projbuild
```kconfig
menu "switch_led Configuration"
	config LED1_GPIO
		int "LED1 GPIO"
		default 4
		help
			GPIO LED1 is connected to. In the book it is 4, the book development board uses 0
	config LED2_GPIO
		int "LED2 GPIO"
		default 5
		help
			GPIO LED2 is connected to. In the book it is 5, the book development board uses 1
			 
	choice MULTIPLEX_METHOD
	    prompt "Type of access for pin multiplexing"
	    default MULTIPLEX_BY_BITMASKING
	    help
	        Select the type of access for pin multiplexing:
	        Use bit masking or use a bitfield
	    config MULTIPLEX_BY_BITMASKING
	        bool "Set Multiplexing by Bitmasking"
	    config MULTIPLEX_WITH_BITFIELD
	        bool "Set Multiplexing with a Bitfield"
    endchoice
endmenu
```

## task_demo/main/Kconfig.projbuild
```kconfig
menu "task_demo Configuration"
choice BUTTON_SYNCH
	prompt "Button Synchronization"
	default BUTTON_SYNCH_SEMAPHORE
	help
		Select the mechanism for button synchronization
		
	config BUTTON_SYNCH_SEMAPHORE
		bool "Semaphore"
		help
			Use a semaphore for button synchronization
			
	config BUTTON_SYNCH_QUEUE
		bool "Queue"
		help
			Use a queue for button synchronization
endchoice

config PRINT_LEDTASK_STATUS
    bool "print LED-Task-Status"
    default false
    help
	Use vTaskGetInfo() in LED-Task function to print task status

endmenu
```

## ticker/components/ticker/Kconfig.projbuild
```kconfig
menu "Ticker Configuration"

config DISPLAY_WIDTH
	int "Display Width"
	default 5
	help
	Display width in pixels (i.e. LEDs).
	
config DISPLAY_HEIGHT
	int "Display Height"
	default 5
	help
	Display height in pixels (i.e. LEDs).
	
config DISPLAY_INTERCHARACTERSPACE
	int "Display inter character space"
	default 1
	help
	Space between characters in pixels
	
config DISPLAY_BRIGHTNESS
	int "Display Brightness"
	default 20
	help
	Brightness of the display (i.e. LEDs).
	
config SCROLL_DELAY
	int "Scroll Delay"
	default 150
	help
	Delay for display scrolling, in milliseconds.
	
endmenu
```

## ticker/main/Kconfig.projbuild
```kconfig
menu "Ticker Example Configuration"

config LED_STRIP_GPIO
    int "LED Strip GPIO"
    default 8
    help
	GPIO the LED strip is connected to.

endmenu
```
